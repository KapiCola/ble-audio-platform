## Firmware/bap_broadcast_source/dongle/Kconfig/boards/Kconfig.nrf52820dongle
```kconfig
# Load board Kconfig descriptions.
osource "C:/ncs/v3.1.1/nrf/boards/nordic/nrf52820dongle/Kconfig.nrf52820dongle"
```

## Firmware/bap_broadcast_source/dongle/Kconfig/boards/Kconfig.sysbuild
```kconfig
# Load Sysbuild board Kconfig descriptions.
osource "C:/ncs/v3.1.1/nrf/boards/nordic/nrf52820dongle/Kconfig.sysbuild"
```

## Firmware/bap_broadcast_source/dongle/bap_broadcast_source/Kconfig/boards/Kconfig.defconfig
```kconfig
# Load Zephyr board defconfig descriptions.
osource "C:/ncs/v3.1.1/nrf/boards/nordic/nrf52820dongle/Kconfig.defconfig"
```
